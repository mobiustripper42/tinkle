#pragma once
#include <Arduino.h>
#include <ESPAsyncWebServer.h>
#include <ArduinoJson.h>
#include <Update.h>   // OTA flash writer (#126) — esp32 core, no external lib
#include "../core/api.h"
#include "flow_sensor.h"
#include "wifi_manager.h"
#include "spa_gz.h"   // generated by tools/build_spa.py from web/index.html (#59)

// Build identity (#126, #159): injected by tools/fw_build_id.py as "<sha>[-dirty]-<UTC
// timestamp>" so /api/status can prove which image is running (the only way to observe
// that an OTA actually took). The timestamp is what makes it change on every flash —
// a git-sha-only identity was unchanged across reflashes that differ only in a gitignored
// build flag. "dev" = built outside git or with the script bypassed.
#ifndef FW_BUILD
#define FW_BUILD "dev"
#endif

// WebServer — the HTTP plumbing for the §10 API (#55/#56). All POLICY lives in
// core Api (host-tested); this file is routes, body collection, and one mutex.
//
// CONCURRENCY: ESPAsyncWebServer handlers run on the async_tcp task (core 0)
// while the cooperative loop owns core 1 — genuine parallelism, so every Api call
// (which reads/mutates RunController & co.) is serialized against the loop with
// one FreeRTOS mutex. The loop takes it for each tick body and releases between
// passes (sub-ms hold when idle), so a handler waits at most a tick or two;
// a handler that can't get it within LOCK_TIMEOUT_MS answers 503 instead of
// blocking the TCP task. The §2 budget is unaffected — an uncontended take is
// tens of cycles. KNOWN BOUND: a handler holds the mutex across its NVS writes
// (postSchedule/postSettings), and a worst-case NVS page-GC pause (~100s of ms)
// stalls the next loop pass — and the 250 ms heartbeat against the ATtiny's 2 s
// timeout — for that long. Margin today is ~10x and edits are operator-rate; if
// the margin ever tightens, defer NVS persistence to the loop side of the lock.
//
// BODY COLLECTION: POST bodies accumulate chunk-by-chunk into a malloc'd buffer
// hung on request->_tempObject (the framework free()s it with the request), then
// the whole body parses once in the final handler. Bodies above BODY_CAP answer
// 413 — the largest legitimate §10 payload (a full 16-entry schedule) is < 2 KB.

namespace tinkle {

class WebServer {
public:
    static constexpr size_t   BODY_CAP        = 4096;
    static constexpr uint32_t LOCK_TIMEOUT_MS = 250;

    WebServer(Api& api, FlowSensor& flowSensor, WifiManager& wifi)
        : server_(80), api_(api), flowSensor_(flowSensor), wifi_(wifi) {}

    void begin() {
        mutex_ = xSemaphoreCreateMutex();

        // The SPA (§10.1, #58/#59): one gzipped page out of PROGMEM. No mutex —
        // it touches no core state. no-cache + ETag: the phone revalidates each
        // load (a 304 is one round trip) so a reflash never serves a stale UI.
        server_.on("/",           HTTP_GET, [](AsyncWebServerRequest* r) { sendSpa(r); });
        server_.on("/index.html", HTTP_GET, [](AsyncWebServerRequest* r) { sendSpa(r); });

        server_.on("/api/status",   HTTP_GET, [this](AsyncWebServerRequest* r) { handleGet(r, Get::Status); });
        server_.on("/api/schedule", HTTP_GET, [this](AsyncWebServerRequest* r) { handleGet(r, Get::Schedule); });
        server_.on("/api/settings", HTTP_GET, [this](AsyncWebServerRequest* r) { handleGet(r, Get::Settings); });
        server_.on("/api/history",  HTTP_GET, [this](AsyncWebServerRequest* r) { handleGet(r, Get::History); });
        server_.on("/api/distributed", HTTP_GET, [this](AsyncWebServerRequest* r) { handleGet(r, Get::Distributed); });

        onPost("/api/run",              Post::Run);
        onPost("/api/stop",             Post::Stop);
        onPost("/api/schedule",         Post::Schedule);
        onPost("/api/settings",         Post::Settings);
        onPost("/api/distributed",      Post::Distributed);
        onPost("/api/calibrate/start",  Post::CalStart);
        onPost("/api/calibrate/finish", Post::CalFinish);
        onPost("/api/fault/clear",      Post::FaultClear);

        // OTA (#126): its own route, NOT onPost — the generic path buffers whole
        // bodies under BODY_CAP (4 KB), while a ~900 KB image must stream chunk-by-
        // chunk straight to Update.write(), never accumulated in RAM. The gate
        // decision (IDLE/FAULT only + the run inhibit) is core Api policy; this is
        // the plumbing. The device is already on the arduino-esp32 default dual-app
        // partition table (app0/app1 + otadata), so no partition work was needed.
        server_.on("/api/ota", HTTP_POST,
            [this](AsyncWebServerRequest* r) { otaFinish(r); },
            [this](AsyncWebServerRequest* r, const String&, size_t index,
                   uint8_t* data, size_t len, bool) { otaChunk(r, index, data, len); });

        server_.onNotFound([](AsyncWebServerRequest* r) {
            r->send(404, "application/json", "{\"error\":\"not found\"}");
        });
        server_.begin();
    }

    // The loop's side of the serialization: wrap each tick body in lock()/unlock().
    void lock()   { if (mutex_) xSemaphoreTake(mutex_, portMAX_DELAY); }
    void unlock() { if (mutex_) xSemaphoreGive(mutex_); }

    // OTA reboot seam (#126): the flash succeeded and the 200 has been queued; the
    // loop (outside its lock) calls ESP.restart() once this reads true. The delay
    // lets the TCP stack flush the response before the connection dies. Restarting
    // from the loop, not the async_tcp task, keeps teardown off the network core.
    // ONE 32-bit word (0 = not pending), not a flag + timestamp pair: a single
    // aligned load/store is atomic on Xtensa, and one word can't be observed
    // half-updated across cores the way two separately-written members could.
    bool restartDue(uint32_t nowMs) const {
        const uint32_t deadline = restartDeadlineMs_;
        return deadline != 0 && (int32_t)(nowMs - deadline) >= 0;
    }

private:
    enum class Get  : uint8_t { Status, Schedule, Settings, History, Distributed };
    enum class Post : uint8_t { Run, Stop, Schedule, Settings, Distributed, CalStart, CalFinish, FaultClear };

    void handleGet(AsyncWebServerRequest* r, Get which) {
        if (!mutex_ || xSemaphoreTake(mutex_, pdMS_TO_TICKS(LOCK_TIMEOUT_MS)) != pdTRUE) {
            r->send(503, "application/json", "{\"error\":\"busy\"}");
            return;
        }
        JsonDocument out;
        int code = 500;
        switch (which) {
            case Get::Status:
                code = api_.getStatus(out, millis());
                // ESP32-only facts the core can't know, merged into the same doc.
                {
                    JsonObject w = out["wifi"].to<JsonObject>();
                    w["mode"] = wifi_.modeName();
                    w["ip"]   = wifi_.ip();
                    w["rssi"] = wifi_.rssi();
                }
                out["uptimeMs"] = millis();
                out["build"]    = FW_BUILD;   // #126/#159: sha+timestamp id — proves which image runs
                break;
            case Get::Schedule: code = api_.getSchedule(out); break;
            case Get::Settings: code = api_.getSettings(out); break;
            case Get::History:  code = api_.getHistory(out, millis()); break;
            case Get::Distributed: code = api_.getDistributed(out); break;
        }
        xSemaphoreGive(mutex_);
        sendJson(r, code, out);
    }

    void onPost(const char* path, Post which) {
        server_.on(path, HTTP_POST,
            [this, which](AsyncWebServerRequest* r) { handlePost(r, which); },
            nullptr,
            // Chunk accumulator: one contiguous buffer, framework-freed. The bounds
            // guard doesn't trust the parser's index/len arithmetic — a future lib
            // swap must degrade to a 400, never a heap overflow.
            [](AsyncWebServerRequest* r, uint8_t* data, size_t len, size_t index, size_t total) {
                if (total > BODY_CAP) return;                  // judged in handlePost
                if (index == 0) r->_tempObject = calloc(total + 1, 1);
                if (r->_tempObject && index + len <= total)
                    memcpy((uint8_t*)r->_tempObject + index, data, len);
            });
    }

    void handlePost(AsyncWebServerRequest* r, Post which) {
        if (r->contentLength() > BODY_CAP) {
            r->send(413, "application/json", "{\"error\":\"body too large\"}");
            return;
        }
        JsonDocument in;
        if (r->_tempObject) {
            if (deserializeJson(in, (const char*)r->_tempObject) != DeserializationError::Ok) {
                r->send(400, "application/json", "{\"error\":\"malformed JSON\"}");
                return;
            }
        }

        if (!mutex_ || xSemaphoreTake(mutex_, pdMS_TO_TICKS(LOCK_TIMEOUT_MS)) != pdTRUE) {
            r->send(503, "application/json", "{\"error\":\"busy\"}");
            return;
        }
        const uint32_t now    = millis();
        const uint32_t pulses = flowSensor_.pulses();
        JsonDocument out;
        JsonVariantConst body = in.as<JsonVariantConst>();
        int code = 500;
        switch (which) {
            case Post::Run:        code = api_.postRun(body, out, now);                   break;
            case Post::Stop:       code = api_.postStop(out, now);                        break;
            case Post::Schedule:   code = api_.postSchedule(body, out, now);              break;
            case Post::Settings:   code = api_.postSettings(body, out, now);              break;
            case Post::Distributed: code = api_.postDistributed(body, out, now);          break;
            case Post::CalStart:   code = api_.postCalStart(body, out, pulses, now);      break;
            case Post::CalFinish:  code = api_.postCalFinish(body, out, pulses, now);     break;
            case Post::FaultClear: code = api_.postFaultClear(out, now);                  break;
        }
        xSemaphoreGive(mutex_);
        sendJson(r, code, out);
    }

    // --- OTA upload (#126) ---------------------------------------------------
    // Runs on the async_tcp task — a single task, so otaChunk/otaFinish calls are
    // serialized even across interleaved requests. The upload state is shared
    // members OWNED by one request at a time (otaOwner_): a second request that
    // starts while one is mid-stream never touches the shared state — it drains
    // silently and otaFinish answers it 409 by pointer identity. Without the
    // ownership check, its index-0 reset would clobber the first upload's state
    // and leak the run inhibit until power cycle.

    void otaChunk(AsyncWebServerRequest* r, size_t index, uint8_t* data, size_t len) {
        if (index == 0) {
            if (otaOwner_ && otaOwner_ != r) return;   // busy — judged in otaFinish
            otaOwner_      = r;
            otaRejectCode_ = 0;
            otaBegun_      = false;
            // Registered at claim time (not begin time) so a rejected request that
            // disconnects before its finish handler still releases ownership — and
            // a dropped mid-flash upload lifts the run inhibit.
            r->onDisconnect([this, r]() {
                if (otaOwner_ != r) return;
                if (otaBegun_) {
                    Update.abort();
                    otaLiftInhibit();
                    otaBegun_ = false;
                }
                otaOwner_ = nullptr;
            });
#ifdef OTA_SECRET
            // Build-time shared secret (untracked ota_secret.ini) — anyone on the
            // LAN can reach this route, and it swaps the firmware. DEC-019 keeps
            // the threat model at "already on the farm Wi-Fi", so a header key is
            // proportionate; without the ini the build runs key-less.
            if (!r->hasHeader("X-OTA-Key") ||
                r->getHeader("X-OTA-Key")->value() != OTA_SECRET) {
                otaRejectCode_ = 401;
                return;
            }
#endif
            if (!mutex_ || xSemaphoreTake(mutex_, pdMS_TO_TICKS(LOCK_TIMEOUT_MS)) != pdTRUE) {
                otaRejectCode_ = 503;
                return;
            }
            JsonDocument gateOut;
            const int code = api_.postOtaBegin(gateOut, millis());   // sets the run inhibit
            xSemaphoreGive(mutex_);
            if (code != 200) { otaRejectCode_ = code; return; }
            if (!Update.begin(UPDATE_SIZE_UNKNOWN)) {
                otaLiftInhibit();
                otaRejectCode_ = 500;
                return;
            }
            otaBegun_ = true;
        }
        if (r != otaOwner_ || otaRejectCode_ || !otaBegun_) return;   // drain silently
        if (Update.write(data, len) != len) {
            Update.abort();
            otaLiftInhibit();
            otaBegun_      = false;
            otaRejectCode_ = 500;
        }
    }

    void otaFinish(AsyncWebServerRequest* r) {
        if (r != otaOwner_) {   // lost the claim race — shared state untouched
            r->send(409, "application/json", "{\"error\":\"OTA already in progress\"}");
            return;
        }
        otaOwner_ = nullptr;    // this request's verdict is final either way
        if (otaRejectCode_) {
            const char* msg = otaRejectCode_ == 401 ? "bad OTA key"
                            : otaRejectCode_ == 409 ? "run active or queued — OTA refused"
                            : otaRejectCode_ == 503 ? "busy"
                                                    : "flash write failed";
            JsonDocument out;
            out["error"] = msg;
            sendJson(r, (int)otaRejectCode_, out);
            return;
        }
        if (!otaBegun_) {
            r->send(400, "application/json", "{\"error\":\"no image uploaded\"}");
            return;
        }
        // end(true) validates the image (magic byte + checksum) BEFORE flipping
        // otadata — a truncated/corrupt upload never becomes the boot target; the
        // old slot keeps booting. That, not bootloader rollback (absent from the
        // stock arduino-esp32 bootloader), is the recoverability story.
        if (Update.end(true)) {
            otaBegun_ = false;
            // Inhibit stays set — nothing may run pre-reboot. 0 means "no deadline",
            // so a wrap landing exactly on 0 nudges to 1.
            uint32_t deadline = millis() + RESTART_DELAY_MS;
            if (deadline == 0) deadline = 1;
            restartDeadlineMs_ = deadline;
            r->send(200, "application/json", "{\"flashed\":true,\"rebooting\":true}");
        } else {
            otaLiftInhibit();
            otaBegun_ = false;
            r->send(500, "application/json", "{\"error\":\"image invalid or incomplete\"}");
        }
    }

    // Clear the run inhibit after a failed upload. Prefer the mutex; on a timeout
    // fall back to the bare call — it's a single aligned bool store (volatile in
    // RunController), and staying latched would brick scheduling until reboot.
    void otaLiftInhibit() {
        if (mutex_ && xSemaphoreTake(mutex_, pdMS_TO_TICKS(LOCK_TIMEOUT_MS)) == pdTRUE) {
            api_.otaAbort();
            xSemaphoreGive(mutex_);
        } else {
            api_.otaAbort();
        }
    }

    static void sendSpa(AsyncWebServerRequest* r) {
        if (r->hasHeader("If-None-Match") &&
            r->getHeader("If-None-Match")->value() == SPA_ETAG) {
            r->send(304);
            return;
        }
        AsyncWebServerResponse* res =
            r->beginResponse_P(200, "text/html", SPA_GZ, SPA_GZ_LEN);
        res->addHeader("Content-Encoding", "gzip");
        res->addHeader("ETag", SPA_ETAG);
        res->addHeader("Cache-Control", "no-cache");
        r->send(res);
    }

    static void sendJson(AsyncWebServerRequest* r, int code, const JsonDocument& doc) {
        String payload;
        serializeJson(doc, payload);
        if (payload.length() == 0) payload = "{}";
        r->send(code, "application/json", payload);
    }

    static constexpr uint32_t RESTART_DELAY_MS = 750;   // let the 200 flush first

    AsyncWebServer    server_;
    Api&              api_;
    FlowSensor&       flowSensor_;
    WifiManager&      wifi_;
    SemaphoreHandle_t mutex_ = nullptr;

    // OTA state (#126). restartDeadlineMs_ crosses tasks (written on async_tcp,
    // read by the loop); the rest is touched only on the async_tcp task, guarded
    // by otaOwner_ identity.
    volatile uint32_t        restartDeadlineMs_ = 0;   // 0 = no reboot pending
    AsyncWebServerRequest*   otaOwner_          = nullptr;
    uint16_t                 otaRejectCode_     = 0;   // non-zero = upload refused
    bool                     otaBegun_          = false;
};

} // namespace tinkle
